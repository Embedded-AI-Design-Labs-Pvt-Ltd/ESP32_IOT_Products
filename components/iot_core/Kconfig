## components/iot_core/Kconfig
```kconfig
# iot_core
menu "IoT Core"

    config IOT_DEVICE_ID_DEFAULT
        string "Default device id (overwritten by provisioning)"
        default "esp32c3-unprovisioned"

    choice IOT_PRODUCT_PROFILE
        prompt "Product application profile"
        default IOT_PROFILE_ENERGY
        help
            Selects which product profile main() starts. Common platform APIs stay unchanged.

        config IOT_PROFILE_ENERGY
            bool "Smart Energy Monitor"
        config IOT_PROFILE_INDUSTRIAL
            bool "Industrial Machine Monitoring"
        config IOT_PROFILE_PREDICTIVE
            bool "Predictive Maintenance Node"
        config IOT_PROFILE_WATER
            bool "Smart Water Meter"
        config IOT_PROFILE_EV_CHARGER
            bool "EV Charger IoT Gateway"
        config IOT_PROFILE_AUTOMOTIVE
            bool "Automotive CAN/IoT Gateway"
        config IOT_PROFILE_ASSET_TRACKER
            bool "BLE Asset Tracker"
        config IOT_PROFILE_AGRICULTURE
            bool "Smart Agriculture Controller"
        config IOT_PROFILE_COLDCHAIN
            bool "Cold-Chain Monitoring Device"
        config IOT_PROFILE_ROBOTICS
            bool "Robotics Telemetry Gateway"
    endchoice

    choice IOT_CLOUD_PROVIDER
        prompt "Cloud MQTT profile"
        default IOT_CLOUD_GENERIC
        config IOT_CLOUD_GENERIC
            bool "Generic MQTTS broker"
        config IOT_CLOUD_AWS_IOT
            bool "AWS IoT Core"
        config IOT_CLOUD_AZURE_IOT
            bool "Azure IoT Hub"
        config IOT_CLOUD_GCP_MQTT
            bool "GCP-compatible MQTT (self-managed)"
    endchoice

endmenu
```

## sdkconfig.defaults
```kconfig
# Target
CONFIG_IDF_TARGET="esp32c3"
CONFIG_ESP_DEFAULT_CPU_FREQ_MHZ_160=y

# Serial / console
CONFIG_ESP_CONSOLE_UART_DEFAULT=y
CONFIG_ESP_CONSOLE_UART_BAUDRATE=115200
CONFIG_LOG_DEFAULT_LEVEL_INFO=y
CONFIG_LOG_TIMESTAMP_SOURCE_RTOS=y

# FreeRTOS
CONFIG_FREERTOS_HZ=1000
CONFIG_FREERTOS_UNICORE=y
CONFIG_FREERTOS_TIMER_TASK_STACK_DEPTH=3072
CONFIG_FREERTOS_IDLE_TASK_STACKSIZE=1536
CONFIG_ESP_MAIN_TASK_STACK_SIZE=6144
CONFIG_FREERTOS_USE_TRACE_FACILITY=y
CONFIG_FREERTOS_USE_STATS_FORMATTING_FUNCTIONS=y
CONFIG_FREERTOS_GENERATE_RUN_TIME_STATS=y
CONFIG_FREERTOS_VTASKLIST_INCLUDE_COREID=y

# Watchdog
CONFIG_ESP_TASK_WDT_EN=y
CONFIG_ESP_TASK_WDT_TIMEOUT_S=10
CONFIG_ESP_TASK_WDT_CHECK_IDLE_TASK_CPU0=y
CONFIG_ESP_INT_WDT=y
CONFIG_ESP_INT_WDT_TIMEOUT_MS=300

# NVS / flash
CONFIG_PARTITION_TABLE_CUSTOM=y
CONFIG_PARTITION_TABLE_CUSTOM_FILENAME="partitions.csv"
CONFIG_PARTITION_TABLE_FILENAME="partitions.csv"
CONFIG_NVS_ENCRYPTION=n
CONFIG_SPI_FLASH_DANGEROUS_WRITE_ABORTS=y

# Wi-Fi / LWIP
CONFIG_ESP_WIFI_SOFTAP_SUPPORT=y
CONFIG_ESP_WIFI_ENABLE_WPA3_SAE=y
CONFIG_LWIP_DHCP_DOES_ARP_CHECK=y
CONFIG_LWIP_MAX_SOCKETS=10

# BLE — NimBLE on C3
CONFIG_BT_ENABLED=y
CONFIG_BT_NIMBLE_ENABLED=y
CONFIG_BT_CONTROLLER_ENABLED=y
CONFIG_BT_NIMBLE_MAX_CONNECTIONS=2
CONFIG_BT_NIMBLE_ROLE_PERIPHERAL=y
CONFIG_BT_NIMBLE_ROLE_CENTRAL=y
CONFIG_BT_NIMBLE_SECURITY_ENABLE=y
CONFIG_BT_NIMBLE_SM_SC=y
CONFIG_BT_NIMBLE_NVS_PERSIST=y

# mbedTLS / TLS
CONFIG_MBEDTLS_CERTIFICATE_BUNDLE=y
CONFIG_MBEDTLS_CERTIFICATE_BUNDLE_DEFAULT_FULL=y
CONFIG_MBEDTLS_SSL_PROTO_TLS1_2=y
CONFIG_MBEDTLS_HARDWARE_AES=y
CONFIG_MBEDTLS_HARDWARE_SHA=y

# MQTT
CONFIG_MQTT_PROTOCOL_311=y
CONFIG_MQTT_TRANSPORT_SSL=y
CONFIG_MQTT_TASK_STACK_SIZE=6144

# OTA
CONFIG_BOOTLOADER_APP_ROLLBACK_ENABLE=y
CONFIG_BOOTLOADER_APP_ANTI_ROLLBACK=n
CONFIG_APP_ROLLBACK_ENABLE=y

# Secure boot / flash encryption are OFF by default (require offline keys).
# Enable in production sdkconfig overlay — see docs/threat-model/secure-boot.md
CONFIG_SECURE_BOOT=n
CONFIG_SECURE_FLASH_ENC_ENABLED=n

# Heap tracing (off in production; enable for leak hunts)
CONFIG_HEAP_TRACING_OFF=y

# Coredump
CONFIG_ESP_COREDUMP_ENABLE_TO_FLASH=y
CONFIG_ESP_COREDUMP_DATA_FORMAT_ELF=y
CONFIG_ESP_COREDUMP_CHECKSUM_CRC32=y

# Default product profile (menuconfig can change)
CONFIG_IOT_PROFILE_ENERGY=y
CONFIG_IOT_CLOUD_GENERIC=y
```
